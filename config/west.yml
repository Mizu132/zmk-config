## config/west.yml
```yaml
manifest:
  defaults:
    revision: v0.4

  remotes:
    - name: zmkfirmware
      url-base: https://github.com/zmkfirmware
    - name: prospector
      url-base: https://github.com/t-ogura
    - name: caksoylar
      url-base: https://github.com/caksoylar

  projects:
    - name: zmk
      remote: zmkfirmware
      import: app/west.yml

    - name: zmk-rgbled-widget
      remote: caksoylar
      revision: main

    - name: prospector-zmk-module
      remote: prospector
      revision: v2.2.3
      path: modules/prospector-zmk-module
      
  self:
    path: config
```
